## bc200_fw/fw/src/drivers/poll_btns/Kconfig
```kconfig
config POLL_BTNS
	bool "poll buttons"

if POLL_BTNS

config POLL_BTNS_DEV_NAME
	string "dev name"
	default "POLL_BTNS"

choice
	prompt "pool buttons log level"

config POLL_BTNS_LOG_LEVEL_CRIT
	bool "Critical"
config POLL_BTNS_LOG_LEVEL_WARN
	bool "Warning"
config POLL_BTNS_LOG_LEVEL_NOTE
	bool "Notice"
config POLL_BTNS_LOG_LEVEL_INFO
	bool "Informational"
config POLL_BTNS_LOG_LEVEL_DEBG
	bool "Debug"
endchoice

config POLL_BTNS_LOG_LEVEL
	int
	default 1 if POLL_BTNS_LOG_LEVEL_CRIT
	default 2 if POLL_BTNS_LOG_LEVEL_WARN
	default 3 if POLL_BTNS_LOG_LEVEL_NOTE
	default 4 if POLL_BTNS_LOG_LEVEL_INFO
	default 5 if POLL_BTNS_LOG_LEVEL_DEBG
	default 0

config POLL_BTNS_INIT_PRIORITY
	int "Default init priority for this drivers"
	default 91
	help
	  Must be uppper then lvgl init priority

source "$(ZEPHYR_POLL_BTNS_MODULE_DIR)/Kconfig.opts"

endif
```

## bc200_fw/fw/src/drivers/st75320/Kconfig
```kconfig
config ST75320
	bool "ST75320 display driver"
	help
	  Enable driver for ST75320 display driver.

config ST75320_INIT_PRIORITY
	int "Default init priority for st75230 drivers"
	default 89
	help
	  Must be upper then spi init priotity and lower then lvgl init priority

source "$(ZEPHYR_ST75320_MODULE_DIR)/Kconfig.opts"
```

## bc200_fw/fw/src/drivers/st75320/Kconfig.opts
```kconfig
if ST75320

if DISPLAY

config SPI
	bool
	default y

if LVGL

config LVGL_DISPLAY_DEV_NAME
	string
	default "ST75320"

config LVGL_HOR_RES_MAXy
	int
	default 160

config LVGL_VER_RES_MAX
	int
	default 240

#choice LVGL_COLOR_DEPTH
#	int
#	default LVGL_COLOR_DEPTH_1
#endchoice

config LVGL_BITS_PER_PIXEL
	int
	default 1

endif # LVGL

endif # DISPLAY

endif # ST75320
```

## bc200_fw/fw/src/drivers/st75320/dts/bindings/sitronix,st75320.yaml
```yaml
# Copyright (c) 2020, Kim Bøndergaard <kim@fam-boendergaard.dk>
# SPDX-License-Identifier: Apache-2.0

description: ST75320 320x240 display controller

compatible: "sitronix,st75320"

include: spi-device.yaml

properties:
    reset-gpios:
      type: phandle-array
      required: true
      description: RESET pin.

        The RESET pin of ST75320 is active low.
        If connected directly the MCU pin should be configured
        as active low.

    cmd-data-gpios:
      type: phandle-array
      required: true
      description: D/CX pin.

        The D/CX pin of ST75320 is active low (transmission command byte).
        If connected directly the MCU pin should be configured
        as active low.

    power-gpios:
      type: phandle-array
      required: false
      description: power enable pin.

        Dedicated pin for switch witch enable/disable lcd module poswer supply.

    backlight-gpios:
      type: phandle-array
      required: false
      description: backlight control pin.

    height:
      type: int
      required: true
      description: Height in pixels of the panel driven by the controller

    width:
      type: int
      required: true
      description: Width in pixels of the panel driven by the controller

    x-offset:
      type: int
      required: true
      description: The column offset in pixels of the LCD to the controller memory

    y-offset:
      type: int
      required: true
      description: The row offset in pixels of the LCD to the controller memory
```
